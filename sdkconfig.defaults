## sdkconfig.defaults
```kconfig
# Target
CONFIG_IDF_TARGET="esp32s3"

# USB-CDC console
CONFIG_ESP_CONSOLE_USB_SERIAL_JTAG=y

# CPU frequency
CONFIG_ESP_DEFAULT_CPU_FREQ_MHZ_240=y

# FreeRTOS tick rate (1ms resolution)
CONFIG_FREERTOS_HZ=1000
```
